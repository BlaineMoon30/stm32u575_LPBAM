# file: stm32u575_nucelo_lpbam.ioc
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CONF1.CORTEX_M33_NS.userName=CORTEX_M33
CONF1.KeepUserPlacement=false
CONF1.Mcu.ContextProject=TrustZoneDisabled
CONF1.Mcu.Family=STM32U5
CONF1.Mcu.IP0=CORTEX_M33_NS
CONF1.Mcu.IP1=ICACHE
CONF1.Mcu.IP2=LPBAM
CONF1.Mcu.IP3=LPBAMQUEUE
CONF1.Mcu.IP4=NVIC
CONF1.Mcu.IP5=PWR
CONF1.Mcu.IP6=RCC
CONF1.Mcu.IP7=SYS
CONF1.Mcu.IPNb=8
CONF1.Mcu.Name=STM32U575ZITxQ
CONF1.Mcu.Package=LQFP144
CONF1.Mcu.Pin0=PE2
CONF1.Mcu.Pin1=PE3
CONF1.Mcu.Pin10=PF2
CONF1.Mcu.Pin100=PG15
CONF1.Mcu.Pin101=PB3 (JTDO/TRACESWO)
CONF1.Mcu.Pin102=PB4 (NJTRST)
CONF1.Mcu.Pin103=PB5
CONF1.Mcu.Pin104=PB6
CONF1.Mcu.Pin105=PB7
CONF1.Mcu.Pin106=PH3-BOOT0
CONF1.Mcu.Pin107=PB8
CONF1.Mcu.Pin108=PB9
CONF1.Mcu.Pin109=PE0
CONF1.Mcu.Pin11=PF3
CONF1.Mcu.Pin110=PE1
CONF1.Mcu.Pin111=VP_ICACHE_VS_ICACHE
CONF1.Mcu.Pin112=VP_LPBAMQUEUE_VS_QUEUE
CONF1.Mcu.Pin113=VP_PWR_VS_SECSignals
CONF1.Mcu.Pin114=VP_PWR_VS_LPOM
CONF1.Mcu.Pin115=VP_SYS_VS_Systick
CONF1.Mcu.Pin116=VP_LPBAM_VS_SIG1
CONF1.Mcu.Pin117=VP_LPBAM_VS_SIG4
CONF1.Mcu.Pin12=PF4
CONF1.Mcu.Pin13=PF5
CONF1.Mcu.Pin14=PF6
CONF1.Mcu.Pin15=PF7
CONF1.Mcu.Pin16=PF8
CONF1.Mcu.Pin17=PF9
CONF1.Mcu.Pin18=PF10
CONF1.Mcu.Pin19=PH0-OSC_IN (PH0)
CONF1.Mcu.Pin2=PE4
CONF1.Mcu.Pin20=PH1-OSC_OUT (PH1)
CONF1.Mcu.Pin21=PC0
CONF1.Mcu.Pin22=PC1
CONF1.Mcu.Pin23=PC2
CONF1.Mcu.Pin24=PC3
CONF1.Mcu.Pin25=PA0
CONF1.Mcu.Pin26=PA1
CONF1.Mcu.Pin27=PA2
CONF1.Mcu.Pin28=PA3
CONF1.Mcu.Pin29=PA4
CONF1.Mcu.Pin3=PE5
CONF1.Mcu.Pin30=PA5
CONF1.Mcu.Pin31=PA6
CONF1.Mcu.Pin32=PA7
CONF1.Mcu.Pin33=PB0
CONF1.Mcu.Pin34=PB1
CONF1.Mcu.Pin35=PB2
CONF1.Mcu.Pin36=PF11
CONF1.Mcu.Pin37=PF12
CONF1.Mcu.Pin38=PF13
CONF1.Mcu.Pin39=PF14
CONF1.Mcu.Pin4=PE6
CONF1.Mcu.Pin40=PF15
CONF1.Mcu.Pin41=PG0
CONF1.Mcu.Pin42=PG1
CONF1.Mcu.Pin43=PE7
CONF1.Mcu.Pin44=PE8
CONF1.Mcu.Pin45=PE9
CONF1.Mcu.Pin46=PE10
CONF1.Mcu.Pin47=PE11
CONF1.Mcu.Pin48=PE12
CONF1.Mcu.Pin49=PE13
CONF1.Mcu.Pin5=PC13
CONF1.Mcu.Pin50=PE14
CONF1.Mcu.Pin51=PE15
CONF1.Mcu.Pin52=PB10
CONF1.Mcu.Pin53=PB11
CONF1.Mcu.Pin54=PB13
CONF1.Mcu.Pin55=PB14
CONF1.Mcu.Pin56=PB15
CONF1.Mcu.Pin57=PD8
CONF1.Mcu.Pin58=PD9
CONF1.Mcu.Pin59=PD10
CONF1.Mcu.Pin6=PC14-OSC32_IN (PC14)
CONF1.Mcu.Pin60=PD11
CONF1.Mcu.Pin61=PD12
CONF1.Mcu.Pin62=PD13
CONF1.Mcu.Pin63=PD14
CONF1.Mcu.Pin64=PD15
CONF1.Mcu.Pin65=PG2
CONF1.Mcu.Pin66=PG3
CONF1.Mcu.Pin67=PG4
CONF1.Mcu.Pin68=PG5
CONF1.Mcu.Pin69=PG6
CONF1.Mcu.Pin7=PC15-OSC32_OUT (PC15)
CONF1.Mcu.Pin70=PG7
CONF1.Mcu.Pin71=PG8
CONF1.Mcu.Pin72=PC6
CONF1.Mcu.Pin73=PC7
CONF1.Mcu.Pin74=PC8
CONF1.Mcu.Pin75=PC9
CONF1.Mcu.Pin76=PA8
CONF1.Mcu.Pin77=PA9
CONF1.Mcu.Pin78=PA10
CONF1.Mcu.Pin79=PA11
CONF1.Mcu.Pin8=PF0
CONF1.Mcu.Pin80=PA12
CONF1.Mcu.Pin81=PA13 (JTMS/SWDIO)
CONF1.Mcu.Pin82=PA14 (JTCK/SWCLK)
CONF1.Mcu.Pin83=PA15 (JTDI)
CONF1.Mcu.Pin84=PC10
CONF1.Mcu.Pin85=PC11
CONF1.Mcu.Pin86=PC12
CONF1.Mcu.Pin87=PD0
CONF1.Mcu.Pin88=PD1
CONF1.Mcu.Pin89=PD2
CONF1.Mcu.Pin9=PF1
CONF1.Mcu.Pin90=PD3
CONF1.Mcu.Pin91=PD4
CONF1.Mcu.Pin92=PD5
CONF1.Mcu.Pin93=PD6
CONF1.Mcu.Pin94=PD7
CONF1.Mcu.Pin95=PG9
CONF1.Mcu.Pin96=PG10
CONF1.Mcu.Pin97=PG12
CONF1.Mcu.Pin98=PG13
CONF1.Mcu.Pin99=PG14
CONF1.Mcu.PinsNb=118
CONF1.Mcu.ThirdPartyNb=0
CONF1.Mcu.UserName=STM32U575ZITxQ
CONF1.NVIC.BusFault_IRQn=true\:0\:0\:false\:false\:true\:false\:false\:false
CONF1.NVIC.DebugMonitor_IRQn=true\:0\:0\:false\:false\:true\:false\:false\:false
CONF1.NVIC.ForceEnableDMAVector=true
CONF1.NVIC.HardFault_IRQn=true\:0\:0\:false\:false\:true\:false\:false\:false
CONF1.NVIC.MemoryManagement_IRQn=true\:0\:0\:false\:false\:true\:false\:false\:false
CONF1.NVIC.NonMaskableInt_IRQn=true\:0\:0\:false\:false\:true\:false\:false\:false
CONF1.NVIC.PendSV_IRQn=true\:0\:0\:false\:false\:true\:false\:false\:false
CONF1.NVIC.PriorityGroup=NVIC_PRIORITYGROUP_4
CONF1.NVIC.SVCall_IRQn=true\:0\:0\:false\:false\:true\:false\:false\:false
CONF1.NVIC.SysTick_IRQn=true\:15\:0\:false\:false\:true\:false\:true\:false
CONF1.NVIC.UsageFault_IRQn=true\:0\:0\:false\:false\:true\:false\:false\:false
CONF1.PA0.Signal=GPIO_Analog
CONF1.PA1.Signal=GPIO_Analog
CONF1.PA10.Signal=GPIO_Analog
CONF1.PA11.Signal=GPIO_Analog
CONF1.PA12.Signal=GPIO_Analog
CONF1.PA13\ (JTMS/SWDIO).Signal=GPIO_Analog
CONF1.PA14\ (JTCK/SWCLK).Signal=GPIO_Analog
CONF1.PA15\ (JTDI).Signal=GPIO_Analog
CONF1.PA2.Signal=GPIO_Analog
CONF1.PA3.Signal=GPIO_Analog
CONF1.PA4.Signal=GPIO_Analog
CONF1.PA5.Signal=GPIO_Analog
CONF1.PA6.Signal=GPIO_Analog
CONF1.PA7.Signal=GPIO_Analog
CONF1.PA8.Signal=GPIO_Analog
CONF1.PA9.Signal=GPIO_Analog
CONF1.PB0.Signal=GPIO_Analog
CONF1.PB1.Signal=GPIO_Analog
CONF1.PB10.Signal=GPIO_Analog
CONF1.PB11.Signal=GPIO_Analog
CONF1.PB13.Signal=GPIO_Analog
CONF1.PB14.Signal=GPIO_Analog
CONF1.PB15.Signal=GPIO_Analog
CONF1.PB2.Signal=GPIO_Analog
CONF1.PB3\ (JTDO/TRACESWO).Signal=GPIO_Analog
CONF1.PB4\ (NJTRST).Signal=GPIO_Analog
CONF1.PB5.Signal=GPIO_Analog
CONF1.PB6.Signal=GPIO_Analog
CONF1.PB7.Signal=GPIO_Analog
CONF1.PB8.Signal=GPIO_Analog
CONF1.PB9.Signal=GPIO_Analog
CONF1.PC0.Signal=GPIO_Analog
CONF1.PC1.Signal=GPIO_Analog
CONF1.PC10.Signal=GPIO_Analog
CONF1.PC11.Signal=GPIO_Analog
CONF1.PC12.Signal=GPIO_Analog
CONF1.PC13.Signal=GPIO_Analog
CONF1.PC14-OSC32_IN\ (PC14).Signal=GPIO_Analog
CONF1.PC15-OSC32_OUT\ (PC15).Signal=GPIO_Analog
CONF1.PC2.Signal=GPIO_Analog
CONF1.PC3.Signal=GPIO_Analog
CONF1.PC6.Signal=GPIO_Analog
CONF1.PC7.Signal=GPIO_Analog
CONF1.PC8.Signal=GPIO_Analog
CONF1.PC9.Signal=GPIO_Analog
CONF1.PD0.Signal=GPIO_Analog
CONF1.PD1.Signal=GPIO_Analog
CONF1.PD10.Signal=GPIO_Analog
CONF1.PD11.Signal=GPIO_Analog
CONF1.PD12.Signal=GPIO_Analog
CONF1.PD13.Signal=GPIO_Analog
CONF1.PD14.Signal=GPIO_Analog
CONF1.PD15.Signal=GPIO_Analog
CONF1.PD2.Signal=GPIO_Analog
CONF1.PD3.Signal=GPIO_Analog
CONF1.PD4.Signal=GPIO_Analog
CONF1.PD5.Signal=GPIO_Analog
CONF1.PD6.Signal=GPIO_Analog
CONF1.PD7.Signal=GPIO_Analog
CONF1.PD8.Signal=GPIO_Analog
CONF1.PD9.Signal=GPIO_Analog
CONF1.PE0.Signal=GPIO_Analog
CONF1.PE1.Signal=GPIO_Analog
CONF1.PE10.Signal=GPIO_Analog
CONF1.PE11.Signal=GPIO_Analog
CONF1.PE12.Signal=GPIO_Analog
CONF1.PE13.Signal=GPIO_Analog
CONF1.PE14.Signal=GPIO_Analog
CONF1.PE15.Signal=GPIO_Analog
CONF1.PE2.Signal=GPIO_Analog
CONF1.PE3.Signal=GPIO_Analog
CONF1.PE4.Signal=GPIO_Analog
CONF1.PE5.Signal=GPIO_Analog
CONF1.PE6.Signal=GPIO_Analog
CONF1.PE7.Signal=GPIO_Analog
CONF1.PE8.Signal=GPIO_Analog
CONF1.PE9.Signal=GPIO_Analog
CONF1.PF0.Signal=GPIO_Analog
CONF1.PF1.Signal=GPIO_Analog
CONF1.PF10.Signal=GPIO_Analog
CONF1.PF11.Signal=GPIO_Analog
CONF1.PF12.Signal=GPIO_Analog
CONF1.PF13.Signal=GPIO_Analog
CONF1.PF14.Signal=GPIO_Analog
CONF1.PF15.Signal=GPIO_Analog
CONF1.PF2.Signal=GPIO_Analog
CONF1.PF3.Signal=GPIO_Analog
CONF1.PF4.Signal=GPIO_Analog
CONF1.PF5.Signal=GPIO_Analog
CONF1.PF6.Signal=GPIO_Analog
CONF1.PF7.Signal=GPIO_Analog
CONF1.PF8.Signal=GPIO_Analog
CONF1.PF9.Signal=GPIO_Analog
CONF1.PG0.Signal=GPIO_Analog
CONF1.PG1.Signal=GPIO_Analog
CONF1.PG10.Signal=GPIO_Analog
CONF1.PG12.Signal=GPIO_Analog
CONF1.PG13.Signal=GPIO_Analog
CONF1.PG14.Signal=GPIO_Analog
CONF1.PG15.Signal=GPIO_Analog
CONF1.PG2.Signal=GPIO_Analog
CONF1.PG3.Signal=GPIO_Analog
CONF1.PG4.Signal=GPIO_Analog
CONF1.PG5.Signal=GPIO_Analog
CONF1.PG6.Signal=GPIO_Analog
CONF1.PG7.Signal=GPIO_Analog
CONF1.PG8.Signal=GPIO_Analog
CONF1.PG9.Signal=GPIO_Analog
CONF1.PH0-OSC_IN\ (PH0).Signal=GPIO_Analog
CONF1.PH1-OSC_OUT\ (PH1).Signal=GPIO_Analog
CONF1.PH3-BOOT0.Signal=GPIO_Analog
CONF1.PWR.PowerMode=PWR_SMPS_SUPPLY
CONF1.RCC.ADCFreq_Value=16000000
CONF1.RCC.CK48Freq_Value=48000000
CONF1.RCC.CRSFreq_Value=48000000
CONF1.RCC.DACCLockSelectionVirtual=RCC_DAC1CLKSOURCE_LSI
CONF1.RCC.DACCLockSelectionVirtualString=RCC_DAC1CLKSOURCE_LSI
CONF1.RCC.DACFreq_Value=32000
CONF1.RCC.EPOD_VALUE=4000000
CONF1.RCC.FDCANFreq_Value=258000000
CONF1.RCC.FamilyName=M
CONF1.RCC.HSE_VALUE=16000000
CONF1.RCC.HSI48_VALUE=48000000
CONF1.RCC.HSI_VALUE=16000000
CONF1.RCC.LSCOPinFreq_Value=32000
CONF1.RCC.LSE_VALUE=32768
CONF1.RCC.LSIDIV_VALUE=32000
CONF1.RCC.LSI_VALUE=32000
CONF1.RCC.MSI_VALUE=4000000
CONF1.RCC.PLL2PoutputFreq_Value=258000000
CONF1.RCC.PLL2QoutputFreq_Value=258000000
CONF1.RCC.PLL2RoutputFreq_Value=258000000
CONF1.RCC.PLL3PoutputFreq_Value=258000000
CONF1.RCC.PLL3QoutputFreq_Value=258000000
CONF1.RCC.PLL3RoutputFreq_Value=258000000
CONF1.RCC.PLLPoutputFreq_Value=258000000
CONF1.RCC.PLLQoutputFreq_Value=258000000
CONF1.RCC.PLLRCLKFreq_Value=258000000
CONF1.RCC.RNGFreq_Value=48000000
CONF1.RCC.SAI1Freq_Value=258000000
CONF1.RCC.SAI2Freq_Value=258000000
CONF1.RCC.SDMMCFreq_Value=258000000
CONF1.RCC.SPI3CLockSelection=RCC_SPI3CLKSOURCE_MSIK
CONF1.RCC.USBFreq_Value=48000000
CONF1.RCC.VCOInput2Freq_Value=4000000
CONF1.RCC.VCOInput3Freq_Value=4000000
CONF1.RCC.VCOInputFreq_Value=4000000
CONF1.RCC.VCOOutputFreq_Value=516000000
CONF1.RCC.VCOPLL2OutputFreq_Value=516000000
CONF1.RCC.VCOPLL3OutputFreq_Value=516000000
CONF1.ScenarioCount=0
CONF1.VP_ICACHE_VS_ICACHE.Mode=DirectMappedCache
CONF1.VP_ICACHE_VS_ICACHE.Signal=ICACHE_VS_ICACHE
CONF1.VP_LPBAMQUEUE_VS_QUEUE.Mode=QUEUEMODE
CONF1.VP_LPBAMQUEUE_VS_QUEUE.Signal=LPBAMQUEUE_VS_QUEUE
CONF1.VP_LPBAM_VS_SIG1.Mode=SmartRun
CONF1.VP_LPBAM_VS_SIG1.Signal=LPBAM_VS_SIG1
CONF1.VP_LPBAM_VS_SIG4.Mode=LPDMA1
CONF1.VP_LPBAM_VS_SIG4.Signal=LPBAM_VS_SIG4
CONF1.VP_PWR_VS_LPOM.Mode=PowerOptimisation
CONF1.VP_PWR_VS_LPOM.Signal=PWR_VS_LPOM
CONF1.VP_PWR_VS_SECSignals.Mode=Security/Privilege
CONF1.VP_PWR_VS_SECSignals.Signal=PWR_VS_SECSignals
CONF1.VP_SYS_VS_Systick.Mode=SysTick
CONF1.VP_SYS_VS_Systick.Signal=SYS_VS_Systick
CONF2.CORTEX_M33_NS.userName=CORTEX_M33
CONF2.ConfName=TXApp
CONF2.KeepUserPlacement=false
CONF2.LPBAMLPGPIO1.NodeLevel-WRITEPIN=LPBAM_GPIO_WRITEPIN_FULLQ_DATA_NODE
CONF2.LPBAMLPGPIO1.QUEUE_NAME=SPI_GPIO_Q
CONF2.LPBAMLPGPIO1.TriggerPolarity=LPBAM_DMA_TRIG_POLARITY_RISING
CONF2.LPBAMLPGPIO1.TriggerSelection=LPBAM_LPDMA1_TRIGGER_LPTIM1_CH1
CONF2.LPBAMSPI3.CircularNode_TRANSMIT_DATA=LPBAM_SPI_TX_DATAQ_CONFIG_NODE
CONF2.LPBAMSPI3.NodeLevel_TRANSMIT_DATA=LPBAM_SPI_TX_DATAQ_CONFIG_NODE
CONF2.LPBAMSPI3.QUEUE_NAME=SPI_GPIO_Q
CONF2.LPBAMSPI3.TriggerPolarity_TRANSMIT_DATA=LPBAM_DMA_TRIG_POLARITY_RISING
CONF2.LPBAMSPI3.TriggerSelection_TRANSMIT_DATA=LPBAM_LPDMA1_TRIGGER_LPTIM1_CH1
CONF2.LPBAMSPI3.WDBufferName_TRANSMIT_DATA=SPIBuff
CONF2.LPBAMSPI3.WDBufferOffset_TRANSMIT_DATA=0
CONF2.LPDMA1.LINKEDLISTMODE_LPDMACH0=DMA_LINKEDLIST_CIRCULAR
CONF2.LPDMA1.LINKEDLISTMODE_LPDMACH1=DMA_LINKEDLIST_CIRCULAR
CONF2.LPTIM1.OCPulse_1=31
CONF2.LPTIM1.Period=63
CONF2.LPTIM3.OCPulse_1=39
CONF2.LPTIM3.Period=79
CONF2.LPUART1.BaudRate=9600
CONF2.LPUART1.DataSize=1
CONF2.LPUART1.Mode=UART_MODE_TX
CONF2.LPUART1.TriggerSelection=LPUART_LPTIM3_OUT_TRG
CONF2.Mcu.ContextProject=TrustZoneDisabled
CONF2.Mcu.Family=STM32U5
CONF2.Mcu.IP0=CORTEX_M33_NS
CONF2.Mcu.IP1=LPBAM
CONF2.Mcu.IP10=PWR
CONF2.Mcu.IP11=RCC
CONF2.Mcu.IP12=SPI3
CONF2.Mcu.IP13=SYS
CONF2.Mcu.IP2=LPBAMLPGPIO1
CONF2.Mcu.IP3=LPBAMQUEUE
CONF2.Mcu.IP4=LPBAMSPI3
CONF2.Mcu.IP5=LPDMA1
CONF2.Mcu.IP6=LPTIM1
CONF2.Mcu.IP7=LPTIM3
CONF2.Mcu.IP8=LPUART1
CONF2.Mcu.IP9=NVIC
CONF2.Mcu.IPNb=14
CONF2.Mcu.Name=STM32U575ZITxQ
CONF2.Mcu.Package=LQFP144
CONF2.Mcu.Pin0=PC0
CONF2.Mcu.Pin1=PA1
CONF2.Mcu.Pin10=VP_LPDMA1_VS_LPDMACH0
CONF2.Mcu.Pin11=VP_LPDMA1_VS_LPDMACH1
CONF2.Mcu.Pin12=VP_LPTIM1_VS_LPTIM_counterModeInternalClock
CONF2.Mcu.Pin13=VP_LPTIM1_VS_CH1
CONF2.Mcu.Pin14=VP_LPTIM1_VS_LPTIM_LPBAM
CONF2.Mcu.Pin15=VP_LPTIM3_VS_LPTIM_counterModeInternalClock
CONF2.Mcu.Pin16=VP_LPTIM3_VS_CH1
CONF2.Mcu.Pin17=VP_LPTIM3_VS_LPTIM_LPBAM
CONF2.Mcu.Pin18=VP_LPUART1_VS_LPUART_LPBAM
CONF2.Mcu.Pin19=VP_PWR_VS_DBSignals
CONF2.Mcu.Pin2=PB2
CONF2.Mcu.Pin20=VP_PWR_VS_LPOM
CONF2.Mcu.Pin21=VP_SPI3_VS_SPI_LPBAM
CONF2.Mcu.Pin22=VP_SYS_VS_Systick
CONF2.Mcu.Pin23=VP_LPBAM_VS_SIG1
CONF2.Mcu.Pin24=VP_LPBAM_VS_SIG4
CONF2.Mcu.Pin3=PB10
CONF2.Mcu.Pin4=PB11
CONF2.Mcu.Pin5=PC10
CONF2.Mcu.Pin6=PC12
CONF2.Mcu.Pin7=VP_LPBAMLPGPIO1_VS_WRITEPIN
CONF2.Mcu.Pin8=VP_LPBAMQUEUE_VS_QUEUE
CONF2.Mcu.Pin9=VP_LPBAMSPI3_VS_TRANSMIT_DATA
CONF2.Mcu.PinsNb=25
CONF2.Mcu.ThirdPartyNb=0
CONF2.Mcu.UserName=STM32U575ZITxQ
CONF2.NVIC.ForceEnableDMAVector=true
CONF2.NVIC.LPUART1_IRQn=true\:0\:0\:false\:false\:true\:true\:true\:true
CONF2.NVIC.PriorityGroup=NVIC_PRIORITYGROUP_4
CONF2.PA1.Signal=LPGPIO_Output
CONF2.PB10.Signal=S_LPTIM3_CH1
CONF2.PB11.Mode=Asynchronous
CONF2.PB11.Signal=LPUART1_TX
CONF2.PB2.Signal=S_LPTIM1_CH1
CONF2.PC0.Mode=Asynchronous
CONF2.PC0.Signal=LPUART1_RX
CONF2.PC10.Mode=TX_Only_Simplex_Unidirect_Master
CONF2.PC10.Signal=SPI3_SCK
CONF2.PC12.Mode=TX_Only_Simplex_Unidirect_Master
CONF2.PC12.Signal=SPI3_MOSI
CONF2.RCC.ADCFreq_Value=16000000
CONF2.RCC.CRSFreq_Value=48000000
CONF2.RCC.DACCLockSelectionVirtual=RCC_DAC1CLKSOURCE_LSI
CONF2.RCC.DACCLockSelectionVirtualString=RCC_DAC1CLKSOURCE_LSI
CONF2.RCC.DACFreq_Value=32000
CONF2.RCC.EPOD_VALUE=4000000
CONF2.RCC.FDCANFreq_Value=258000000
CONF2.RCC.FamilyName=M
CONF2.RCC.HSE_VALUE=16000000
CONF2.RCC.HSI48_VALUE=48000000
CONF2.RCC.HSI_VALUE=16000000
CONF2.RCC.I2C1Freq_Value=16000000
CONF2.RCC.I2C2Freq_Value=16000000
CONF2.RCC.I2C3Freq_Value=16000000
CONF2.RCC.I2C4Freq_Value=16000000
CONF2.RCC.LPTIM1CLockSelectionVirtual=RCC_LPTIM1CLKSOURCE_LSI
CONF2.RCC.LPTIM1Freq_Value=32000
CONF2.RCC.LPTIM2Freq_Value=16000000
CONF2.RCC.LPTIM3CLockSelectionVirtual=RCC_LPTIM34CLKSOURCE_LSI
CONF2.RCC.LPTIM3Freq_Value=32000
CONF2.RCC.LPUART1CLockSelectionVirtual=RCC_LPUART1CLKSOURCE_MSIK
CONF2.RCC.LPUART1Freq_Value=4000000
CONF2.RCC.LSCOPinFreq_Value=32000
CONF2.RCC.LSE_VALUE=32768
CONF2.RCC.LSIDIV_VALUE=32000
CONF2.RCC.LSI_VALUE=32000
CONF2.RCC.MSI_VALUE=4000000
CONF2.RCC.PLL2PoutputFreq_Value=258000000
CONF2.RCC.PLL2QoutputFreq_Value=258000000
CONF2.RCC.PLL2RoutputFreq_Value=258000000
CONF2.RCC.PLL3PoutputFreq_Value=258000000
CONF2.RCC.PLL3QoutputFreq_Value=258000000
CONF2.RCC.PLL3RoutputFreq_Value=258000000
CONF2.RCC.PLLPoutputFreq_Value=258000000
CONF2.RCC.PLLQoutputFreq_Value=258000000
CONF2.RCC.PLLRCLKFreq_Value=258000000
CONF2.RCC.RNGFreq_Value=16000000
CONF2.RCC.SAI1Freq_Value=16000000
CONF2.RCC.SAI2Freq_Value=16000000
CONF2.RCC.SPI1Freq_Value=16000000
CONF2.RCC.SPI2Freq_Value=16000000
CONF2.RCC.SPI3CLockSelection=RCC_SPI3CLKSOURCE_MSIK
CONF2.RCC.SPI3Freq_Value=4000000
CONF2.RCC.UART4Freq_Value=16000000
CONF2.RCC.UART5Freq_Value=16000000
CONF2.RCC.USART1Freq_Value=16000000
CONF2.RCC.USART2Freq_Value=16000000
CONF2.RCC.USART3Freq_Value=16000000
CONF2.RCC.USBFreq_Value=4000000
CONF2.RCC.VCOInput2Freq_Value=4000000
CONF2.RCC.VCOInput3Freq_Value=4000000
CONF2.RCC.VCOInputFreq_Value=4000000
CONF2.RCC.VCOOutputFreq_Value=516000000
CONF2.RCC.VCOPLL2OutputFreq_Value=516000000
CONF2.RCC.VCOPLL3OutputFreq_Value=516000000
CONF2.S1.Q1.F1.FuncUserName=SPI_TX
CONF2.S1.Q1.F1.FuncVirtualPinList=VP_LPBAMSPI3_VS_TRANSMIT_DATA
CONF2.S1.Q1.F1.IpInstanceName=LPBAMSPI3
CONF2.S1.Q1.F1.LPBAMSPI3.CircularNode_TRANSMIT_DATA=LPBAM_SPI_TX_DATAQ_CONFIG_NODE
CONF2.S1.Q1.F1.LPBAMSPI3.NodeLevel_TRANSMIT_DATA=LPBAM_SPI_TX_DATAQ_CONFIG_NODE
CONF2.S1.Q1.F1.LPBAMSPI3.QUEUE_NAME=SPI_GPIO_Q
CONF2.S1.Q1.F1.LPBAMSPI3.TriggerPolarity_TRANSMIT_DATA=LPBAM_DMA_TRIG_POLARITY_RISING
CONF2.S1.Q1.F1.LPBAMSPI3.TriggerSelection_TRANSMIT_DATA=LPBAM_LPDMA1_TRIGGER_LPTIM1_CH1
CONF2.S1.Q1.F1.LPBAMSPI3.WDBufferName_TRANSMIT_DATA=SPIBuff
CONF2.S1.Q1.F1.LPBAMSPI3.WDBufferOffset_TRANSMIT_DATA=0
CONF2.S1.Q1.F1.VP_LPBAMSPI3_VS_TRANSMIT_DATA.Mode=TRANSMIT_DATA
CONF2.S1.Q1.F1.VP_LPBAMSPI3_VS_TRANSMIT_DATA.Signal=LPBAMSPI3_VS_TRANSMIT_DATA
CONF2.S1.Q1.F2.FuncUserName=PinSet
CONF2.S1.Q1.F2.FuncVirtualPinList=VP_LPBAMLPGPIO1_VS_WRITEPIN
CONF2.S1.Q1.F2.IpInstanceName=LPBAMLPGPIO1
CONF2.S1.Q1.F2.LPBAMLPGPIO1.NodeLevel-WRITEPIN=LPBAM_GPIO_WRITEPIN_FULLQ_DATA_NODE
CONF2.S1.Q1.F2.LPBAMLPGPIO1.PinState_WRITEPIN=LPBAM_GPIO_PIN_SET
CONF2.S1.Q1.F2.LPBAMLPGPIO1.QUEUE_NAME=SPI_GPIO_Q
CONF2.S1.Q1.F2.LPBAMLPGPIO1.TriggerPolarity=LPBAM_DMA_TRIG_POLARITY_RISING
CONF2.S1.Q1.F2.LPBAMLPGPIO1.TriggerSelection=LPBAM_LPDMA1_TRIGGER_LPTIM1_CH1
CONF2.S1.Q1.F2.VP_LPBAMLPGPIO1_VS_WRITEPIN.Mode=WRITEPIN
CONF2.S1.Q1.F2.VP_LPBAMLPGPIO1_VS_WRITEPIN.Signal=LPBAMLPGPIO1_VS_WRITEPIN
CONF2.S1.Q1.F3.FuncUserName=PinReset
CONF2.S1.Q1.F3.FuncVirtualPinList=VP_LPBAMLPGPIO1_VS_WRITEPIN
CONF2.S1.Q1.F3.IpInstanceName=LPBAMLPGPIO1
CONF2.S1.Q1.F3.LPBAMLPGPIO1.NodeLevel-WRITEPIN=LPBAM_GPIO_WRITEPIN_FULLQ_DATA_NODE
CONF2.S1.Q1.F3.LPBAMLPGPIO1.QUEUE_NAME=SPI_GPIO_Q
CONF2.S1.Q1.F3.LPBAMLPGPIO1.TriggerPolarity=LPBAM_DMA_TRIG_POLARITY_RISING
CONF2.S1.Q1.F3.LPBAMLPGPIO1.TriggerSelection=LPBAM_LPDMA1_TRIGGER_LPTIM1_CH1
CONF2.S1.Q1.F3.VP_LPBAMLPGPIO1_VS_WRITEPIN.Mode=WRITEPIN
CONF2.S1.Q1.F3.VP_LPBAMLPGPIO1_VS_WRITEPIN.Signal=LPBAMLPGPIO1_VS_WRITEPIN
CONF2.S1.Q1.FuncCount=3
CONF2.S1.Q1.FuncLastActive=F3
CONF2.S1.Q1.IpInstanceName=LPBAMQUEUE
CONF2.S1.Q1.QueueCircularity=1
CONF2.S1.Q1.QueueUserName=SPI_GPIO
CONF2.S1.Q1.QueueVirtualPinList=VP_LPBAMQUEUE_VS_QUEUE
CONF2.S1.Q1.VP_LPBAMQUEUE_VS_QUEUE.Mode=QUEUEMODE
CONF2.S1.Q1.VP_LPBAMQUEUE_VS_QUEUE.Signal=LPBAMQUEUE_VS_QUEUE
CONF2.S1.Q2.F1.FuncUserName=UART_TX
CONF2.S1.Q2.F1.FuncVirtualPinList=VP_LPBAMLPUART1_VS_TRANSMIT_DATA
CONF2.S1.Q2.F1.IpInstanceName=LPBAMLPUART1
CONF2.S1.Q2.F1.LPBAMLPUART1.BufferName=UARTBuff
CONF2.S1.Q2.F1.LPBAMLPUART1.BufferOffset=0
CONF2.S1.Q2.F1.LPBAMLPUART1.CircularNode_TRANSMIT_DATA=LPBAM_UART_TX_DATAQ_DATA_NODE
CONF2.S1.Q2.F1.LPBAMLPUART1.NodeLevel_TRANSMIT_DATA=LPBAM_UART_TX_DATAQ_CONFIG_NODE
CONF2.S1.Q2.F1.LPBAMLPUART1.QUEUE_NAME=UART_Q
CONF2.S1.Q2.F1.LPBAMLPUART1.Size=1
CONF2.S1.Q2.F1.LPBAMLPUART1.TriggerPolarity_TRANSMIT_DATA=LPBAM_DMA_TRIG_POLARITY_RISING
CONF2.S1.Q2.F1.LPBAMLPUART1.TriggerSelection_TRANSMIT_DATA=LPBAM_LPDMA1_TRIGGER_LPTIM3_CH1
CONF2.S1.Q2.F1.VP_LPBAMLPUART1_VS_TRANSMIT_DATA.Mode=TRANSMIT_DATA
CONF2.S1.Q2.F1.VP_LPBAMLPUART1_VS_TRANSMIT_DATA.Signal=LPBAMLPUART1_VS_TRANSMIT_DATA
CONF2.S1.Q2.FuncCount=1
CONF2.S1.Q2.FuncLastActive=F1
CONF2.S1.Q2.IpInstanceName=LPBAMQUEUE
CONF2.S1.Q2.QueueCircularity=1
CONF2.S1.Q2.QueueUserName=UART
CONF2.S1.Q2.QueueVirtualPinList=VP_LPBAMQUEUE_VS_QUEUE
CONF2.S1.Q2.VP_LPBAMQUEUE_VS_QUEUE.Mode=QUEUEMODE
CONF2.S1.Q2.VP_LPBAMQUEUE_VS_QUEUE.Signal=LPBAMQUEUE_VS_QUEUE
CONF2.S1.QueueCount=2
CONF2.S1.QueueLastActive=Q2
CONF2.S1.ScenarioName=TxData
CONF2.SH.S_LPTIM1_CH1.0=LPTIM1_CH1,OutputIO_CH1
CONF2.SH.S_LPTIM3_CH1.0=LPTIM3_CH1,OutputIO_CH1
CONF2.SPI3.BaudRatePrescaler=SPI_BAUDRATEPRESCALER_256
CONF2.SPI3.CalculateBaudRate=15.625 KBits/s
CONF2.SPI3.Direction=SPI_DIRECTION_2LINES_TXONLY
CONF2.SPI3.Mode=SPI_MODE_MASTER
CONF2.SPI3.TriggerSelection=SPI_GRP2_LPTIM1_CH1_TRG
CONF2.SPI3.VirtualType=VM_MASTER
CONF2.ScenarioCount=1
CONF2.VP_LPBAM_VS_SIG1.Mode=SmartRun
CONF2.VP_LPBAM_VS_SIG1.Signal=LPBAM_VS_SIG1
CONF2.VP_LPBAM_VS_SIG4.Mode=LPDMA1
CONF2.VP_LPBAM_VS_SIG4.Signal=LPBAM_VS_SIG4
CONF2.VP_LPDMA1_VS_LPDMACH0.Mode=LINKEDLIST_LPDMACH0
CONF2.VP_LPDMA1_VS_LPDMACH0.Signal=LPDMA1_VS_LPDMACH0
CONF2.VP_LPDMA1_VS_LPDMACH1.Mode=LINKEDLIST_LPDMACH1
CONF2.VP_LPDMA1_VS_LPDMACH1.Signal=LPDMA1_VS_LPDMACH1
CONF2.VP_LPTIM1_VS_CH1.Mode=Channel_1_Active
CONF2.VP_LPTIM1_VS_CH1.Signal=LPTIM1_VS_CH1
CONF2.VP_LPTIM1_VS_LPTIM_LPBAM.Mode=LPBAMSPECIFIC
CONF2.VP_LPTIM1_VS_LPTIM_LPBAM.Signal=LPTIM1_VS_LPTIM_LPBAM
CONF2.VP_LPTIM1_VS_LPTIM_counterModeInternalClock.Mode=Counts__internal_clock_event_00
CONF2.VP_LPTIM1_VS_LPTIM_counterModeInternalClock.Signal=LPTIM1_VS_LPTIM_counterModeInternalClock
CONF2.VP_LPTIM3_VS_CH1.Mode=Channel_1_Active
CONF2.VP_LPTIM3_VS_CH1.Signal=LPTIM3_VS_CH1
CONF2.VP_LPTIM3_VS_LPTIM_LPBAM.Mode=LPBAMSPECIFIC
CONF2.VP_LPTIM3_VS_LPTIM_LPBAM.Signal=LPTIM3_VS_LPTIM_LPBAM
CONF2.VP_LPTIM3_VS_LPTIM_counterModeInternalClock.Mode=Counts__internal_clock_event_00
CONF2.VP_LPTIM3_VS_LPTIM_counterModeInternalClock.Signal=LPTIM3_VS_LPTIM_counterModeInternalClock
CONF2.VP_LPUART1_VS_LPUART_LPBAM.Mode=LPBAMSPECIFIC
CONF2.VP_LPUART1_VS_LPUART_LPBAM.Signal=LPUART1_VS_LPUART_LPBAM
CONF2.VP_PWR_VS_DBSignals.Mode=DisableDeadBatterySignals
CONF2.VP_PWR_VS_DBSignals.Signal=PWR_VS_DBSignals
CONF2.VP_PWR_VS_LPOM.Mode=PowerOptimisation
CONF2.VP_PWR_VS_LPOM.Signal=PWR_VS_LPOM
CONF2.VP_SPI3_VS_SPI_LPBAM.Mode=LPBAMSPECIFIC
CONF2.VP_SPI3_VS_SPI_LPBAM.Signal=SPI3_VS_SPI_LPBAM
CONF2.VP_SYS_VS_Systick.Mode=SysTick
CONF2.VP_SYS_VS_Systick.Signal=SYS_VS_Systick
Mcu.Family=STM32U5
Mcu.Name=STM32U575ZITxQ
Mcu.Package=LQFP144
MultiConf.NbConfig=2
ProjectManager.HeapSize=0x200
ProjectManager.StackSize=0x400
ProjectManager.TargetToolchain=STM32CubeIDE
board=custom

// file: Core/Src/main.c
/* USER CODE BEGIN Header */
/**
  ******************************************************************************
  * @file           : main.c
  * @brief          : Main program body
  ******************************************************************************
  * @attention
  *
  * Copyright (c) 2022 STMicroelectronics.
  * All rights reserved.
  *
  * This software is licensed under terms that can be found in the LICENSE file
  * in the root directory of this software component.
  * If no LICENSE file comes with this software, it is provided AS-IS.
  *
  ******************************************************************************
  */
/* USER CODE END Header */
#include "main.h"

/* USER CODE BEGIN Includes */
#include "lpbam_txapp.h"
/* USER CODE END Includes */

DMA_HandleTypeDef handle_LPDMA1_Channel0;
DMA_HandleTypeDef handle_LPDMA1_Channel1;
LPTIM_HandleTypeDef hlptim1;
LPTIM_HandleTypeDef hlptim3;
UART_HandleTypeDef hlpuart1;
SPI_HandleTypeDef hspi3;
/* USER CODE BEGIN PV */
uint8_t SPIBuff[] = {0x12};
uint8_t UARTBuff[] = {'!'};
DMA_HandleTypeDef *LPDMA_Handlers[2] =
{
    &handle_LPDMA1_Channel0,
    &handle_LPDMA1_Channel1
};
/* USER CODE END PV */

void SystemClock_Config(void);
static void SystemPower_Config(void);
static void MX_GPIO_Init(void);
static void MX_ICACHE_Init(void);

int main(void)
{

  /* MCU Configuration--------------------------------------------------------*/

  /* Reset of all peripherals, Initializes the Flash interface and the Systick. */
  HAL_Init();

  /* Configure the system clock */
  SystemClock_Config();

  /* Configure the System Power */
  SystemPower_Config();

  /* Initialize all configured peripherals */
  MX_GPIO_Init();
  MX_ICACHE_Init();
  /* USER CODE BEGIN 2 */
  HAL_Delay(5000);

  MX_TXApp_Init();
  MX_TXApp_TxData_Init();
  MX_TXApp_TxData_Build();
  MX_TXApp_TxData_Link(LPDMA_Handlers[0]);
  MX_TXApp_TxData_Start(LPDMA_Handlers[0]);
  __HAL_RCC_PWR_CLK_ENABLE();
  HAL_PWREx_EnterSTOP2Mode(PWR_STOPENTRY_WFI);
  /* USER CODE END 2 */

  /* Infinite loop */
  while (1)
  {

  }
}

void SystemClock_Config(void)
{
  RCC_OscInitTypeDef RCC_OscInitStruct = {0};
  RCC_ClkInitTypeDef RCC_ClkInitStruct = {0};

  /** Configure the main internal regulator output voltage
  */
  if (HAL_PWREx_ControlVoltageScaling(PWR_REGULATOR_VOLTAGE_SCALE4) != HAL_OK)
  {
    Error_Handler();
  }

  /** Initializes the CPU, AHB and APB buses clocks
  */
  RCC_OscInitStruct.OscillatorType = RCC_OSCILLATORTYPE_MSI;
  RCC_OscInitStruct.MSIState = RCC_MSI_ON;
  RCC_OscInitStruct.MSICalibrationValue = RCC_MSICALIBRATION_DEFAULT;
  RCC_OscInitStruct.MSIClockRange = RCC_MSIRANGE_4;
  RCC_OscInitStruct.PLL.PLLState = RCC_PLL_NONE;
  if (HAL_RCC_OscConfig(&RCC_OscInitStruct) != HAL_OK)
  {
    Error_Handler();
  }

  /** Initializes the CPU, AHB and APB buses clocks
  */
  RCC_ClkInitStruct.ClockType = RCC_CLOCKTYPE_HCLK|RCC_CLOCKTYPE_SYSCLK
                              |RCC_CLOCKTYPE_PCLK1|RCC_CLOCKTYPE_PCLK2
                              |RCC_CLOCKTYPE_PCLK3;
  RCC_ClkInitStruct.SYSCLKSource = RCC_SYSCLKSOURCE_MSI;
  RCC_ClkInitStruct.AHBCLKDivider = RCC_SYSCLK_DIV1;
  RCC_ClkInitStruct.APB1CLKDivider = RCC_HCLK_DIV1;
  RCC_ClkInitStruct.APB2CLKDivider = RCC_HCLK_DIV1;
  RCC_ClkInitStruct.APB3CLKDivider = RCC_HCLK_DIV1;

  if (HAL_RCC_ClockConfig(&RCC_ClkInitStruct, FLASH_LATENCY_0) != HAL_OK)
  {
    Error_Handler();
  }
}

/**
  * @brief Power Configuration
  * @retval None
  */
static void SystemPower_Config(void)
{
  HAL_PWREx_EnableVddIO2();

  /*
   * Switch to SMPS regulator instead of LDO
   */
  if (HAL_PWREx_ConfigSupply(PWR_SMPS_SUPPLY) != HAL_OK)
  {
    Error_Handler();
  }
}

static void MX_ICACHE_Init(void)
{

  /** Enable instruction cache in 1-way (direct mapped cache)
  */
  if (HAL_ICACHE_ConfigAssociativityMode(ICACHE_1WAY) != HAL_OK)
  {
    Error_Handler();
  }
  if (HAL_ICACHE_Enable() != HAL_OK)
  {
    Error_Handler();
  }

}

static void MX_GPIO_Init(void)
{
  GPIO_InitTypeDef GPIO_InitStruct = {0};

  /* GPIO Ports Clock Enable */
  __HAL_RCC_GPIOE_CLK_ENABLE();
  __HAL_RCC_GPIOC_CLK_ENABLE();
  __HAL_RCC_GPIOF_CLK_ENABLE();
  __HAL_RCC_GPIOH_CLK_ENABLE();
  __HAL_RCC_GPIOA_CLK_ENABLE();
  __HAL_RCC_GPIOB_CLK_ENABLE();
  __HAL_RCC_GPIOG_CLK_ENABLE();
  __HAL_RCC_GPIOD_CLK_ENABLE();

  /*Configure GPIO pins : PE2 PE3 PE4 PE5
                           PE6 PE7 PE8 PE9
                           PE10 PE11 PE12 PE13
                           PE14 PE15 PE0 PE1 */
  GPIO_InitStruct.Pin = GPIO_PIN_2|GPIO_PIN_3|GPIO_PIN_4|GPIO_PIN_5
                          |GPIO_PIN_6|GPIO_PIN_7|GPIO_PIN_8|GPIO_PIN_9
                          |GPIO_PIN_10|GPIO_PIN_11|GPIO_PIN_12|GPIO_PIN_13
                          |GPIO_PIN_14|GPIO_PIN_15|GPIO_PIN_0|GPIO_PIN_1;
  GPIO_InitStruct.Mode = GPIO_MODE_ANALOG;
  GPIO_InitStruct.Pull = GPIO_NOPULL;
  HAL_GPIO_Init(GPIOE, &GPIO_InitStruct);

  /*Configure GPIO pins : PC13 PC14 PC15 PC0
                           PC1 PC2 PC3 PC6
                           PC7 PC8 PC9 PC10
                           PC11 PC12 */
  GPIO_InitStruct.Pin = GPIO_PIN_13|GPIO_PIN_14|GPIO_PIN_15|GPIO_PIN_0
                          |GPIO_PIN_1|GPIO_PIN_2|GPIO_PIN_3|GPIO_PIN_6
                          |GPIO_PIN_7|GPIO_PIN_8|GPIO_PIN_9|GPIO_PIN_10
                          |GPIO_PIN_11|GPIO_PIN_12;
  GPIO_InitStruct.Mode = GPIO_MODE_ANALOG;
  GPIO_InitStruct.Pull = GPIO_NOPULL;
  HAL_GPIO_Init(GPIOC, &GPIO_InitStruct);

  /*Configure GPIO pins : PF0 PF1 PF2 PF3
                           PF4 PF5 PF6 PF7
                           PF8 PF9 PF10 PF11
                           PF12 PF13 PF14 PF15 */
  GPIO_InitStruct.Pin = GPIO_PIN_0|GPIO_PIN_1|GPIO_PIN_2|GPIO_PIN_3
                          |GPIO_PIN_4|GPIO_PIN_5|GPIO_PIN_6|GPIO_PIN_7
                          |GPIO_PIN_8|GPIO_PIN_9|GPIO_PIN_10|GPIO_PIN_11
                          |GPIO_PIN_12|GPIO_PIN_13|GPIO_PIN_14|GPIO_PIN_15;
  GPIO_InitStruct.Mode = GPIO_MODE_ANALOG;
  GPIO_InitStruct.Pull = GPIO_NOPULL;
  HAL_GPIO_Init(GPIOF, &GPIO_InitStruct);

  /*Configure GPIO pins : PH0 PH1 PH3 */
  GPIO_InitStruct.Pin = GPIO_PIN_0|GPIO_PIN_1|GPIO_PIN_3;
  GPIO_InitStruct.Mode = GPIO_MODE_ANALOG;
  GPIO_InitStruct.Pull = GPIO_NOPULL;
  HAL_GPIO_Init(GPIOH, &GPIO_InitStruct);

  /*Configure GPIO pins : PA0 PA1 PA2 PA3
                           PA4 PA5 PA6 PA7
                           PA8 PA9 PA10 PA11
                           PA12 PA13 PA14 PA15 */
  GPIO_InitStruct.Pin = GPIO_PIN_0|GPIO_PIN_1|GPIO_PIN_2|GPIO_PIN_3
                          |GPIO_PIN_4|GPIO_PIN_5|GPIO_PIN_6|GPIO_PIN_7
                          |GPIO_PIN_8|GPIO_PIN_9|GPIO_PIN_10|GPIO_PIN_11
                          |GPIO_PIN_12|GPIO_PIN_13|GPIO_PIN_14|GPIO_PIN_15;
  GPIO_InitStruct.Mode = GPIO_MODE_ANALOG;
  GPIO_InitStruct.Pull = GPIO_NOPULL;
  HAL_GPIO_Init(GPIOA, &GPIO_InitStruct);

  /*Configure GPIO pins : PB0 PB1 PB2 PB10
                           PB11 PB13 PB14 PB15
                           PB3 PB4 PB5 PB6
                           PB7 PB8 PB9 */
  GPIO_InitStruct.Pin = GPIO_PIN_0|GPIO_PIN_1|GPIO_PIN_2|GPIO_PIN_10
                          |GPIO_PIN_11|GPIO_PIN_13|GPIO_PIN_14|GPIO_PIN_15
                          |GPIO_PIN_3|GPIO_PIN_4|GPIO_PIN_5|GPIO_PIN_6
                          |GPIO_PIN_7|GPIO_PIN_8|GPIO_PIN_9;
  GPIO_InitStruct.Mode = GPIO_MODE_ANALOG;
  GPIO_InitStruct.Pull = GPIO_NOPULL;
  HAL_GPIO_Init(GPIOB, &GPIO_InitStruct);

  /*Configure GPIO pins : PG0 PG1 PG2 PG3
                           PG4 PG5 PG6 PG7
                           PG8 PG9 PG10 PG12
                           PG13 PG14 PG15 */
  GPIO_InitStruct.Pin = GPIO_PIN_0|GPIO_PIN_1|GPIO_PIN_2|GPIO_PIN_3
                          |GPIO_PIN_4|GPIO_PIN_5|GPIO_PIN_6|GPIO_PIN_7
                          |GPIO_PIN_8|GPIO_PIN_9|GPIO_PIN_10|GPIO_PIN_12
                          |GPIO_PIN_13|GPIO_PIN_14|GPIO_PIN_15;
  GPIO_InitStruct.Mode = GPIO_MODE_ANALOG;
  GPIO_InitStruct.Pull = GPIO_NOPULL;
  HAL_GPIO_Init(GPIOG, &GPIO_InitStruct);

  /*Configure GPIO pins : PD8 PD9 PD10 PD11
                           PD12 PD13 PD14 PD15
                           PD0 PD1 PD2 PD3
                           PD4 PD5 PD6 PD7 */
  GPIO_InitStruct.Pin = GPIO_PIN_8|GPIO_PIN_9|GPIO_PIN_10|GPIO_PIN_11
                          |GPIO_PIN_12|GPIO_PIN_13|GPIO_PIN_14|GPIO_PIN_15
                          |GPIO_PIN_0|GPIO_PIN_1|GPIO_PIN_2|GPIO_PIN_3
                          |GPIO_PIN_4|GPIO_PIN_5|GPIO_PIN_6|GPIO_PIN_7;
  GPIO_InitStruct.Mode = GPIO_MODE_ANALOG;
  GPIO_InitStruct.Pull = GPIO_NOPULL;
  HAL_GPIO_Init(GPIOD, &GPIO_InitStruct);

}

void Error_Handler(void)
{
  __disable_irq();
  while (1)
  {
  }
}
